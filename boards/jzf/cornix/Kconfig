## boards/jzf/cornix/Kconfig
```kconfig
config BOARD_CORNIX_CHARGER
    bool "Enable battery charger"
    default y
    depends on ( BOARD_CORNIX_LEFT || BOARD_CORNIX_RIGHT || BOARD_CORNIX_PH_LEFT )
```

## boards/shields/cornix_indicator/Kconfig.defconfig
```kconfig
if SHIELD_CORNIX_INDICATOR && ZMK_SPLIT_ROLE_CENTRAL

config ZMK_HID_INDICATORS
	default y

endif # SHIELD_CORNIX_INDICATOR && ZMK_SPLIT_ROLE_CENTRAL
```

## config/west.yml
```yaml
manifest:
  remotes:
    - name: zmkfirmware
      url-base: https://github.com/zmkfirmware
    - name: hitsmaxft
      url-base: https://github.com/hitsmaxft
    - name: englmaxi
      url-base: https://github.com/englmaxi
    - name: urob
      url-base: https://github.com/urob
    - name: janpfischer
      url-base: https://github.com/janpfischer
  projects:
    # Revisions pinned to each repo's main on 2026-07-11; the indicator shield
    # links against ZMK-internal symbols, so bump these deliberately and rebuild.
    - name: zmk
      remote: zmkfirmware
      revision: 904c9aec8822d79149d42c8a9a77e8828eb08f5a
      clone-depth: 1
      import:
        file: app/west.yml
    - name: zmk-helpers
      remote: urob
      revision: bc114546392b4615ac90a99140eaf21dde31209d
      clone-depth: 1
    #- name: zmk-rgbled-widget
    #  remote: hitsmaxft
    #  revision: main
    #  clone-depth: 1
    - name: zmk-dongle-display
      remote: englmaxi
      revision: 2bb333f87136d33e94a49d86236ed9ec254a8060
      clone-depth: 1
    #- name: zmk-dongle-screen
    #  remote: janpfischer
    #  revision: main
    #  clone-depth: 1
  self:
    path: config
```
